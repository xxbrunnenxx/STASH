## firmware/main/Kconfig.projbuild
```kconfig
menu "STASH Board"

    comment "Vorgaben stammen aus Waveshares eigenem Referenzcode für dieses"
    comment "Board (waveshareteam/ESP32-S3-ePaper-3.97, Beispiel 08). Wer eine"
    comment "andere Revision hat, überschreibt sie hier."

    menu "E-Paper"
        config STASH_EPD_SPI_HOST
            int "SPI-Host (1 = SPI2, 2 = SPI3)"
            default 2
        config STASH_EPD_SCK
            int "SCK"
            default 11
        config STASH_EPD_MOSI
            int "MOSI / DIN"
            default 12
        config STASH_EPD_CS
            int "CS"
            default 10
        config STASH_EPD_DC
            int "DC"
            default 9
        config STASH_EPD_RST
            int "RST"
            default 46
        config STASH_EPD_BUSY
            int "BUSY"
            default 3
        config STASH_EPD_PWR
            int "PWR-Enable (-1, wenn das Panel dauerhaft versorgt wird)"
            default -1
    endmenu

    menu "SD-Karte"
        comment "Waveshares Referenzcode nutzt SDMMC im 4-Bit-Modus, keine SPI."
        config STASH_SD_D0
            int "D0"
            default 15
        config STASH_SD_D1
            int "D1"
            default 7
        config STASH_SD_D2
            int "D2"
            default 8
        config STASH_SD_D3
            int "D3"
            default 18
        config STASH_SD_CLK
            int "CLK"
            default 16
        config STASH_SD_CMD
            int "CMD"
            default 17
    endmenu

    menu "I2C-Bus (RTC, SHTC3, Akku, IMU)"
        config STASH_I2C_SDA
            int "SDA"
            default 41
        config STASH_I2C_SCL
            int "SCL"
            default 42
        config STASH_I2C_FREQ_HZ
            int "Takt in Hz"
            default 400000
    endmenu

    menu "Audio (ES8311)"
        config STASH_I2S_MCLK
            int "I2S MCLK"
            default 13
        config STASH_I2S_BCLK
            int "I2S BCLK"
            default 14
        config STASH_I2S_WS
            int "I2S WS / LRCK"
            default 47
        config STASH_I2S_DIN
            int "I2S DIN (Mikrofon in den ESP)"
            default 21
        config STASH_MIC_GAIN_DB
            int "Mikrofonverstärkung in dB"
            default 30
            range 0 42
    endmenu

    menu "Bedienung"
        comment "Drehknopf: drei Richtungen (als Up/Function/Down verdrahtet)."
        comment "Aufnehmen liegt auf BOOT."
        config STASH_KNOPF_LINKS
            int "Drehknopf links (Up)"
            default 4
        config STASH_KNOPF_MITTE
            int "Drehknopf drücken (Function)"
            default 5
        config STASH_KNOPF_RECHTS
            int "Drehknopf rechts (Down)"
            default 6
        config STASH_TASTE_REC
            int "BOOT-Taste (aufnehmen)"
            default 0
    endmenu

    menu "Akku (AXP2101)"
        comment "Power-Management-Chip laut Referenzcode AXP2101 (I2C 0x34),"
        comment "nicht TG28 — dieser Name in der Stückliste war falsch."
        config STASH_AXP2101_ADDR
            hex "I2C-Adresse"
            default 0x34
    endmenu

endmenu

menu "STASH Netz"
    config STASH_WLAN_SSID
        string "WLAN-SSID (2,4 GHz)"
        default ""
    config STASH_WLAN_PASSWORT
        string "WLAN-Passwort"
        default ""
    config STASH_BRAIN_HOST
        string "Adresse des Brain"
        default "pi5-brain.local"
    config STASH_BRAIN_PORT
        int "Port des Brain"
        default 8080
    config STASH_NETZ_INTERVALL_S
        int "Sekunden zwischen zwei Netzversuchen"
        default 30
    config STASH_RUHE_NACH_S
        int "Sekunden ohne Bedienung bis zur Sperrseite"
        default 180
        help
            Danach fällt das Gerät auf „Heute" zurück, zeichnet einmal sauber
            durch und legt das Panel schlafen. E-Paper hält das Bild ohne
            Strom — die Seite steht dann, bis wieder jemand drückt.
endmenu
```
